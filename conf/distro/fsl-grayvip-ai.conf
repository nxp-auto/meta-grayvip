## conf/distro/fsl-grayvip-ai.conf
```bitbake
require conf/distro/include/fsl-grayvip-base.inc

DISTRO = "fsl-grayvip-ai"

UBOOT_ENV_INC_NAME:append = " distro_boot"
DISTRO_FEATURES:append = " nxp-ara2"

DISTROOVERRIDES =. "fsl-grayvip:"

# Disable DDR ECC
DDR_ECC_SUPPORT = "0"
```

## conf/distro/fsl-grayvip.conf
```bitbake
require conf/distro/include/fsl-grayvip-base.inc

DISTRO = "fsl-grayvip"
DISTRO_FEATURES:append = " nxp-motionwise nxp-cloud-gw"
```
